## drivers/exmdm/Kconfig
```kconfig
menuconfig NEW_EXMDM
	bool "External Modem Control Support"
	help
	  Say Y to enable Linux external modem control support.
	  This allows control of supported external modem from
	  both userspace and optionally, by kernel events (triggers).

if NEW_EXMDM

config EXMDM_CLASS
	bool "External Modem Control Class Support"
	help
	  This option enables the external modem sysfs class in
	  /sys/class/exmdm. You will need this to do anything useful
	  with external modem. If unsure, say N.

comment "External Modem Control drivers"

config EXMDM_STE_U300
	bool "External Modem Control Support for STE U300"
	select EXMDM_CLASS
	help
	  This option enables support for STE U300.

config EXMDM_HUAWEI_820U
	bool "External Modem Control Support for Huawei 820u"
	select EXMDM_CLASS
	help
	  This option enables support for external modem Huawei 820u.

config EXMDM_SIERRA_8705
	bool "External Modem Control Support for Sierra 8705"
	select EXMDM_CLASS
	help
	  This option enables support for external modem Sierra 8705.

endif # NEW_EXMDM
```

## drivers/media/video/msm/Kconfig
```kconfig
comment "Camera Sensor Selection"
config MT9T013
	bool "Sensor mt9t013 (BAYER 3M)"
	depends on MSM_CAMERA && !ARCH_MSM8X60
	default y
	---help---
	  MICRON 3M Bayer Sensor with AutoFocus

config MT9D112
	bool "Sensor mt9d112 (YUV 2M)"
	depends on MSM_CAMERA && !ARCH_MSM8X60
	default y
	---help---
	  MICRON 2M YUV Sensor
config IMX074
	bool "Sensor IMX074 (BAYER 13.5M)"
	depends on MSM_CAMERA && ARCH_MSM8X60
	default y
	---help---
	SONY 13.5 MP Bayer Sensor
config WEBCAM_OV7692
	bool "Sensor OV7692 (VGA YUV)"
	depends on MSM_CAMERA && ARCH_MSM8X60
	default y
	---help---
	  Omni Vision VGA YUV Sensor.
#	This Senosr is used as a webcam.
#	This uses the CSI interface.
#	Need to enable CSI1 clks for this sensor.
config WEBCAM_MT9M113
	bool "Sensor MT9M113 (1.3M YUV)"
	depends on MSM_CAMERA && ARCH_MSM8X60
	default y
	---help---
	  Aptina 1.3M YUV Sensor.
#	This Senosr is used as a webcam.
#	This uses the CSI interface.
#	Need to enable CSI1 clks for this sensor.
config VX6953
	bool "Sensor VX6953 (BAYER 5M)"
	depends on MSM_CAMERA && ARCH_MSM8X60
	default y
	---help---
	STM 5M Bayer Sensor with EDOF
config SN12M0PZ
	bool "Sensor sn12m0pz (Bayer 12 MP)"
	depends on MSM_CAMERA && ARCH_MSM7X30
	default y
	---help---
	  Sony 12 MP Bayer Sensor
config MT9P012
	bool "Sensor mt9p012 (BAYER 5M)"
	depends on MSM_CAMERA && !ARCH_MSM8X60
	default y
	---help---
	  MICRON 5M Bayer Sensor with Autofocus

choice
	prompt "AF module"
	depends on MT9P012 && !ARCH_MSM8X60
	default MSM_CAMERA_AF_FOXCONN

config MSM_CAMERA_AF_FOXCONN
	bool "FOXCONN Module"
	help
	  This driver supports FOXCONN AF module for 5M Bayer sensor

config MSM_CAMERA_AF_BAM
	bool "BAM Module"
	help
	  This driver supports BAM AF module for 5M Bayer sensor

endchoice

config MT9P012_KM
	bool "Sensor mt9p012 KM module (BAYER 5M)"
	depends on MSM_CAMERA && !ARCH_MSM8X60
	default y
	---help---
	  MICRON 5M Bayer Sensor KM modules with Autofocus

config S5K3E2FX
	bool "Sensor s5k3e2fx (Samsung 5M)"
	depends on MSM_CAMERA && !ARCH_MSM8X60
	default y
	---help---
	  Samsung 5M with Autofocus

config VB6801
	bool "Sensor vb6801"
	depends on MSM_CAMERA && !ARCH_MSM8X60
	---help---
	  5M with flash

config MSM_CAMERA_FLASH
	bool "Qualcomm MSM camera flash support"
	depends on MSM_CAMERA
	default y
	---help---
	  Enable support for LED flash for msm camera

config MSM_GEMINI
	tristate "Qualcomm MSM Gemini Jpeg Engine support"
	depends on MSM_CAMERA && (ARCH_MSM7X30 || ARCH_MSM8X60)
	default M
	---help---
	  Enable support for Gemini Jpeg Engine

config MSM_VPE
	tristate "Qualcomm MSM Video Pre-processing Engine support"
	depends on MSM_CAMERA && (ARCH_MSM7X30 || ARCH_MSM8X60)
	default y
	---help---
	  Enable support for Video Pre-processing Engine

config QUP_EXCLUSIVE_TO_CAMERA
	bool "QUP exclusive to camera"
	depends on MSM_CAMERA
	default y
	---help---
	  This flag enabled states that QUP
	  is exclusive to camera. In case this
	  is disabled, the lvs1 voltage is enabled
	  by QUP in the board file as QUP is used by
	  applications other than camera.
```

## drivers/misc/mpu3050/Kconfig
```kconfig
config SENSORS_MPU3050
        tristate "MPU3050 Gyroscope Driver"
        depends on I2C
        help
         If you say yes here you get support for the MPU3050 Gyroscope driver
         This driver can also be built as a module.  If so, the module
         will be called mpu3050.

config SENSORS_MPU3050_DEBUG
    bool "MPU3050 debug"
    depends on SENSORS_MPU3050
    help
      If you say yes here you get extra debug messages from the MPU3050
      and other slave sensors.

if SENSORS_MPU3050
choice
    prompt "Accelerometer Type"
    depends on SENSORS_MPU3050
    default SENSORS_BMA150

config SENSORS_ACCELEROMETER_NONE
    bool "NONE"
    help
      This disables accelerometer support for the MPU3050

config SENSORS_ADXL346
    bool "ADI adxl346"
    help
      This enables support for the ADI adxl346 accelerometer

config SENSORS_BMA150
    bool "Bosch BMA150"
    help
      This enables support for the Bosch BMA150 accelerometer

config SENSORS_BMA222
    bool "Bosch BMA222"
    help
      This enables support for the Bosch BMA222 accelerometer
      
config SENSORS_KXSD9
    bool "Kionix KXSD9"
    help
      This enables support for the Kionix KXSD9 accelerometer

config SENSORS_KXTF9
    bool "Kionix KXTF9"
    help
      This enables support for the Kionix KXFT9 accelerometer

config SENSORS_LIS331DLH
    bool "ST lis331dlh"
    help
      This enables support for the ST lis331dlh accelerometer

config SENSORS_LSM303DLHA
    bool "ST lsm303dlh"
    help
      This enables support for the ST lsm303dlh accelerometer

config SENSORS_MMA8450
    bool "Freescale mma8450"
    help
      This enables support for the Freescale mma8450 accelerometer

config SENSORS_MMA8451
    bool "Freescale mma8451"
    help
      This enables support for the Freescale mma8451 accelerometer
endchoice

choice
    prompt "Compass Type"
    depends on SENSORS_MPU3050
    default SENSORS_AK8975_GYRO

config SENSORS_COMPASS_NONE
    bool "NONE"
    help
      This disables compass support for the MPU3050

config SENSORS_AK8975_GYRO
    bool "AKM ak8975"
    help
      This enables support for the AKM ak8975 compass

config SENSORS_MMC314X
    bool "MEMSIC mmc314x"
    help
      This enables support for the MEMSIC mmc314x compass

config SENSORS_AMI304
    bool "Aichi Steel ami304"
    help
      This enables support for the Aichi Steel ami304 compass

config SENSORS_HMC5883
    bool "Honeywell hmc5883"
    help
      This enables support for the Honeywell hmc5883 compass

config SENSORS_LSM303DLHM
    bool "ST lsm303dlh"
    help
      This enables support for the ST lsm303dlh compass

config SENSORS_MMC314X
    bool "MEMSIC mmc314xMS"
    help
      This enables support for the MEMSIC mmc314xMS compass

config SENSORS_YAS529
    bool "Yamaha yas529"
    help
      This enables support for the Yamaha yas529 compass

endchoice

endif #SENSORS_MPU3050
```

## drivers/net/wireless/ar6003/Kconfig
```kconfig
config AR6003
	tristate "Atheros 6003 (802.11n) wireless cards support"
	depends on WIRELESS_EXT && MMC
	---help---
	  This module adds support for wireless adapters based on
	  Atheros 6003 chipset.

	  This driver uses the kernel's wireless extensions subsystem.

	  Say M if unsure.

config AR6003_FW_PATH
	depends on AR6003
	string "Firmware path"
	default "/system/etc/firmware/fw_ar6003.bin"
	---help---
	  Path to the firmware file.

config AR6003_NVRAM_PATH
	depends on AR6003
	string "NVRAM path"
	default "/proc/calibration"
	---help---
	  Path to the calibration file.
```
